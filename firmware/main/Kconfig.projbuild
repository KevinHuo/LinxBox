## firmware/main/Kconfig.projbuild
```kconfig
menu "LinX 网络与语音"

    config LINX_GATEWAY_ENABLE
        bool "启用 Gateway 会话与请求界面"
        default n
        help
            从已认证 WSS 读取会话、历史与正文，按通知刷新。
            录音前固定目标，灵矽 Agent 通过 MCP 发送；设备不上传识别文字。
            未配置时显示真实错误，不回退演示。
            灵矽 ASR 固定路由与逐轮请求 ID 透传仍需平台联调。

    config LINX_GATEWAY_URL
        string "Gateway WebSocket 地址"
        depends on LINX_GATEWAY_ENABLE
        default ""
        help
            使用 wss:// 地址，校验证书和主机名；不把 MAC 作为认证凭据。
            开发服务使用 ws:// 时须显式打开 LINX_GATEWAY_ALLOW_WS。

    config LINX_GATEWAY_ALLOW_WS
        bool "允许 Gateway 使用明文 WS"
        depends on LINX_GATEWAY_ENABLE
        default n
        help
            仅供明确使用 ws:// 的开发服务，设备令牌和协议内容不会加密。
            默认关闭；WSS 继续校验证书和主机名，灵矽语音仍只使用 WSS。

    config LINX_GATEWAY_TOKEN
        string "Gateway 设备令牌"
        depends on LINX_GATEWAY_ENABLE
        default ""
        help
            仅填写令牌，不加 Bearer 前缀。由设备配置注入，不写日志。
            本机 sdkconfig 及固件可能包含凭据，不应公开分享。

    config LINX_VOICE_ENABLE
        bool "在语音页启用真实灵矽对话"
        default y
        help
            进入语音页时连接 Wi-Fi 和灵矽，使用麦克风采集并播放智能体回复。
            未启用 Gateway 时，关闭本项保留离线界面，不启动网络和音频。
            Gateway 模式共用设备运行，按服务端准备结果开启单轮录音。

    config LINX_WIFI_SSID
        string "开发用 Wi-Fi 名称（无已保存网络时回退）"
        depends on LINX_VOICE_ENABLE || LINX_GATEWAY_ENABLE
        default ""
        help
            日常使用通过设备设置打开手机网页配网，选择网络并输入密码。
            优先读取设备 NVS；只有未保存网络时才使用此开发配置。

    config LINX_WIFI_PASSWORD
        string "开发用 Wi-Fi 密码"
        depends on LINX_VOICE_ENABLE || LINX_GATEWAY_ENABLE
        default ""
        help
            本机 sdkconfig 和生成的固件会包含此配置，不应分享这些文件。
            灵矽令牌由设备绑定后的 HTTPS 网关动态获取，不写入源码。

endmenu
```

## firmware/sdkconfig.defaults
```kconfig
# --- 目标芯片 ---
CONFIG_IDF_TARGET="esp32c3"
# 注:ESP32-C3 无 PSRAM,故不设 CONFIG_SPIRAM。

# --- Flash ---
# FoloToy AI Passport 当前产品/固件基线使用 8MB Flash。
CONFIG_ESPTOOLPY_FLASHSIZE_8MB=y
# 固定 8MB 镜像头，关闭 detect，便于 idf.py merge-bin。
CONFIG_ESPTOOLPY_HEADER_FLASHSIZE_UPDATE=n
# 默认模板只保留 NVS、PHY data 和占用剩余空间的 factory app；用户可按需修改。
CONFIG_PARTITION_TABLE_CUSTOM=y
CONFIG_PARTITION_TABLE_CUSTOM_FILENAME="partitions.csv"
CONFIG_PARTITION_TABLE_FILENAME="partitions.csv"

# --- 控制台:USB-Serial-JTAG(C3 原生 USB,GPIO18/19)---
# 不用 UART0:其默认 TX=GPIO21 与本板背光引脚冲突。
CONFIG_ESP_CONSOLE_USB_SERIAL_JTAG=y
CONFIG_ESP_CONSOLE_SECONDARY_NONE=y

# --- LVGL ---
CONFIG_LV_COLOR_DEPTH_16=y
# 20 ms display refresh period targets up to 50 FPS when rendering and SPI
# transfer complete within the same budget.
CONFIG_LV_DEF_REFR_PERIOD=20
CONFIG_LV_FONT_MONTSERRAT_14=y
CONFIG_LV_FONT_MONTSERRAT_20=y
# LVGL 内置 malloc 池大小(KB)。它是独立静态区、不与系统堆共享,配大了会白白占用 RAM。
# 本 demo UI 简单,24KB 足够;若自建复杂界面出现绘制卡死/看门狗,调大此值。
CONFIG_LV_MEM_SIZE_KILOBYTES=40
CONFIG_LV_TXT_ENC_UTF8=y
CONFIG_LV_USE_FONT_PLACEHOLDER=y

# --- 系统 ---
CONFIG_FREERTOS_HZ=1000

# 灵矽网络与音频仅在进入语音页后启动，保留离线构建选项。
CONFIG_LINX_LINGXI_ENABLE=y
CONFIG_BT_ENABLED=n
CONFIG_MBEDTLS_CERTIFICATE_BUNDLE=y
CONFIG_WS_TRANSPORT=y
CONFIG_WS_BUFFER_SIZE=2048
# 冷启动校时保留三个时间源，由 SDK 在无应答时顺序轮换。
CONFIG_LWIP_SNTP_MAX_SERVERS=3
# 无 PSRAM：限制无线缓存，音频按 20 ms 分块，不保存整段录音。
CONFIG_ESP_WIFI_STATIC_RX_BUFFER_NUM=4
CONFIG_ESP_WIFI_DYNAMIC_RX_BUFFER_NUM=8
CONFIG_ESP_WIFI_DYNAMIC_TX_BUFFER_NUM=8
# 直接调用 Opus 解码器，不注册其他编解码器或容器。
CONFIG_AUDIO_DECODER_OPUS_SUPPORT=y
CONFIG_AUDIO_DECODER_AAC_SUPPORT=n
CONFIG_AUDIO_DECODER_MP3_SUPPORT=n
CONFIG_AUDIO_DECODER_G711_SUPPORT=n
CONFIG_AUDIO_DECODER_AMRNB_SUPPORT=n
CONFIG_AUDIO_DECODER_AMRWB_SUPPORT=n
CONFIG_AUDIO_DECODER_FLAC_SUPPORT=n
CONFIG_AUDIO_DECODER_VORBIS_SUPPORT=n
CONFIG_AUDIO_DECODER_ADPCM_SUPPORT=n
CONFIG_AUDIO_DECODER_ALAC_SUPPORT=n
CONFIG_AUDIO_DECODER_PCM_SUPPORT=n
CONFIG_AUDIO_DECODER_SBC_SUPPORT=n
CONFIG_AUDIO_DECODER_LC3_SUPPORT=n
CONFIG_AUDIO_DECODER_G722_SUPPORT=n
CONFIG_AUDIO_ENCODER_AAC_SUPPORT=n
CONFIG_AUDIO_ENCODER_G711_SUPPORT=n
CONFIG_AUDIO_ENCODER_AMRNB_SUPPORT=n
CONFIG_AUDIO_ENCODER_AMRWB_SUPPORT=n
CONFIG_AUDIO_ENCODER_OPUS_SUPPORT=n
CONFIG_AUDIO_ENCODER_ADPCM_SUPPORT=n
CONFIG_AUDIO_ENCODER_ALAC_SUPPORT=n
CONFIG_AUDIO_ENCODER_PCM_SUPPORT=n
CONFIG_AUDIO_ENCODER_SBC_SUPPORT=n
CONFIG_AUDIO_ENCODER_LC3_SUPPORT=n
CONFIG_AUDIO_ENCODER_G722_SUPPORT=n
CONFIG_AUDIO_SIMPLE_DEC_WAV_SUPPORT=n
CONFIG_AUDIO_SIMPLE_DEC_M4A_SUPPORT=n
CONFIG_AUDIO_SIMPLE_DEC_TS_SUPPORT=n
CONFIG_AUDIO_SIMPLE_DEC_OGG_SUPPORT=n
CONFIG_ESP_WIFI_SOFTAP_SUPPORT=y
```
